//This source file is provided under MIT License terms.
//Copyright (c) 2013 Calypso Ventures, Inc.
//
//Permission is hereby granted, free of charge, to any person obtaining a copy
//of this software and associated documentation files (the "Software"), to deal
//in the Software without restriction, including without limitation the rights
//to use, copy, modify, merge, publish, distribute, sublicense, and/or sell
//copies of the Software, and to permit persons to whom the Software is
//furnished to do so, subject to the following conditions:
//
//The above copyright notice and this permission notice shall be included in
//all copies or substantial portions of the Software.
//
//THE SOFTWARE IS PROVIDED "AS IS", WITHOUT WARRANTY OF ANY KIND, EXPRESS OR
//IMPLIED, INCLUDING BUT NOT LIMITED TO THE WARRANTIES OF MERCHANTABILITY,
//FITNESS FOR A PARTICULAR PURPOSE AND NONINFRINGEMENT. IN NO EVENT SHALL THE
//AUTHORS OR COPYRIGHT HOLDERS BE LIABLE FOR ANY CLAIM, DAMAGES OR OTHER
//LIABILITY, WHETHER IN AN ACTION OF CONTRACT, TORT OR OTHERWISE, ARISING FROM,
//OUT OF OR IN CONNECTION WITH THE SOFTWARE OR THE USE OR OTHER DEALINGS IN
//THE SOFTWARE.

/dts-v1/;
/plugin/;

/ {
	compatible = "ti,beaglebone", "ti,beaglebone-black";

	/* identification */
	part-number = "BB-LCNC-K9";
	version = "00A0";

	/* state the resources this cape uses */
	exclusive-use =
		/* the pin header uses */
/*		"J8.3",        gpio1_6  */
/*		"J8.4",        gpio1_7  */
/*		"J8.5",        gpio1_2  */
/*		"J8.6",        gpio1_3  */
		"J8.7",     /* gpio2_2  */
		"J8.8",     /* gpio2_3  */
		"J8.9",     /* gpio2_5  */
		"J8.10",    /* gpio2_4  */
		"J8.11",    /* gpio1_13 */
		"J8.12",    /* gpio1_12 */
		"J8.13",    /* gpio0_23 */
		"J8.14",    /* gpio0_26 */
		"J8.15",    /* gpio1_15 */
		"J8.16",    /* gpio1_14 */
		"J8.17",    /* gpio0_27 */
		"J8.18",    /* gpio2_1  */
		"J8.19",    /* gpio0_22 */
/*		"J8.20",       gpio1_31 */
/*		"J8.21",       gpio1_30 */
/*		"J8.22",       gpio1_5  */
/*		"J8.23",       gpio1_4  */
/*		"J8.24",       gpio1_1  */
/*		"J8.25",       gpio1_0  */
		"J8.26",    /* gpio1_29 */
/*		"J8.27",       gpio2_22 */
/*		"J8.28",       gpio2_24 */
/*		"J8.29",       gpio2_23 */
/*		"J8.30",       gpio2_25 */
/*		"J8.31",       gpio0_10 */
/*		"J8.32",       gpio0_11 */
/*		"J8.33",       gpio0_9  */
/*		"J8.34",       gpio2_17 */
/*		"J8.35",       gpio0_8  */
/*		"J8.36",       gpio2_16 */
/*		"J8.37",       gpio2_14 */
/*		"J8.38",       gpio2_15 */
/*		"J8.39",       gpio2_12 */
/*		"J8.40",       gpio2_13 */
/*		"J8.41",       gpio2_10 */
/*		"J8.42",       gpio2_11 */
/*		"J8.43",       gpio2_8  */
/*		"J8.44",       gpio2_9  */
/*		"J8.45",       gpio2_6  */
/*		"J8.46",       gpio2_7  */
		
		"J9.11",    /* gpio0_30 */
		"J9.12",    /* gpio1_28 */
		"J9.13",    /* gpio0_31 */
		"J9.14",    /* gpio1_18 */
		"J9.15",    /* gpio1_16 */
		"J9.16",    /* gpio1_19 */
		"J9.17",    /* gpio0_5  */
		"J9.18",    /* gpio0_4  */
/*		"J9.19",       gpio0_13 */
/*		"J9.20",       gpio0_12 */
		"J9.21",    /* gpio0_3  */
		"J9.22",    /* gpio0_2  */
		"J9.23",    /* gpio1_17 */
		"J9.24",    /* gpio0_15 */
		"J9.25",    /* gpio3_21 */
		"J9.26",    /* gpio0_14 */
		"J9.27",    /* gpio3_19 */
		"J9.28",    /* gpio3_17 */
		"J9.29",    /* gpio3_15 */
		"J9.30",    /* gpio3_16 */
		"J9.31",    /* gpio3_14 */
		"J9.41",    /* gpio3_20 */
		"J9.42",    /* gpio3_18 */
		
		/* the hardware IP uses */
/*		"gpio1_6",	*/
/*		"gpio1_7",	*/
/*		"gpio1_2",	*/
/*		"gpio1_3",	*/
		"gpio2_2",
		"gpio2_3",
		"gpio2_5",
		"gpio2_4",
		"gpio1_13",
		"gpio1_12",
		"gpio0_23",
		"gpio0_26",
		"gpio1_15",
		"gpio1_14",
		"gpio0_27",
		"gpio2_1",
		"gpio0_22",
/*		"gpio1_31",	*/
/*		"gpio1_30",	*/
/*		"gpio1_5",	*/
/*		"gpio1_4",	*/
/*		"gpio1_1",	*/
/*		"gpio1_0",	*/
		"gpio1_29",
/*		"gpio2_22",	*/
/*		"gpio2_24",	*/
/*		"gpio2_23",	*/
/*		"gpio2_25",	*/
/*		"gpio0_10",	*/
/*		"gpio0_11",	*/
/*		"gpio0_9",	*/
/*		"gpio2_17",	*/
/*		"gpio0_8",	*/
/*		"gpio2_16",	*/
/*		"gpio2_14",	*/
/*		"gpio2_15",	*/
/*		"gpio2_12",	*/
/*		"gpio2_13",	*/
/*		"gpio2_10",	*/
/*		"gpio2_11",	*/
/*		"gpio2_8",	*/
/*		"gpio2_9",	*/
/*		"gpio2_6",	*/
/*		"gpio2_7",	*/
		
		"gpio0_30",
		"gpio1_28",
		"gpio0_31",
		"gpio1_18",
		"gpio1_16",
		"gpio1_19",
		"gpio0_5",
		"gpio0_4",
/*		"gpio0_13",	*/
/*		"gpio0_12",	*/
		"gpio0_3",
		"gpio0_2",
		"gpio1_17",
		"gpio0_15",
		"gpio3_21",
		"gpio0_14",
		"gpio3_19",
		"gpio3_17",
		"gpio3_15",
		"gpio3_16",
		"gpio3_14",
		"gpio3_20",
		"gpio3_18",
		
		"pru0";

	fragment@0 {
		target = <&am33xx_pinmux>;
		__overlay__ {

			K9_gpio_pins: K9_gpio_pins {
				pinctrl-single,pins = <
/*					0x018     mmc      J8.3   gpio1_6  */       
/*					0x01C     mmc      J8.4   gpio1_7  */       
/*					0x008     mmc      J8.5   gpio1_2  */       
/*					0x00C     mmc      J8.6   gpio1_3  */       
					0x090     0x3F  /* J8.7   gpio2_2  */       
					0x094     0x3F  /* J8.8   gpio2_3  */       
					0x09C     0x3F  /* J8.9   gpio2_5  */       
					0x098     0x3F  /* J8.10  gpio2_4  */       
					0x034     0x3F  /* J8.11  gpio1_13 */       
					0x030     0x3F  /* J8.12  gpio1_12 */       
					0x024     0x3F  /* J8.13  gpio0_23 */       
					0x028     0x3F  /* J8.14  gpio0_26 */       
					0x03C     0x3F  /* J8.15  gpio1_15 */       
					0x038     0x3F  /* J8.16  gpio1_14 */       
					0x02C     0x3F  /* J8.17  gpio0_27 */       
					0x08C     0x3F  /* J8.18  gpio2_1  */       
					0x020     0x3F  /* J8.19  gpio0_22 */       
/*					0x084     mmc      J8.20  gpio1_31 */       
/*					0x080     mmc      J8.21  gpio1_30 */       
/*					0x014     mmc      J8.22  gpio1_5  */       
/*					0x010     mmc      J8.23  gpio1_4  */       
/*					0x004     mmc      J8.24  gpio1_1  */       
/*					0x000     mmc      J8.25  gpio1_0  */       
					0x07C     0x3F  /* J8.26  gpio1_29 */       
/*					0x0E0     0x3F     J8.27  gpio2_22 */       
/*					0x0E8     0x3F     J8.28  gpio2_24 */       
/*					0x0E4     0x3F     J8.29  gpio2_23 */       
/*					0x0EC     0x3F     J8.30  gpio2_25 */       
/*					0x0D8     0x3F     J8.31  gpio0_10 */       
/*					0x0DC     0x3F     J8.32  gpio0_11 */       
/*					0x0D4     0x3F     J8.33  gpio0_9  */       
/*					0x0CC     0x3F     J8.34  gpio2_17 */       
/*					0x0D0     0x3F     J8.35  gpio0_8  */       
/*					0x0C8     0x3F     J8.36  gpio2_16 */       
/*					0x0C0     0x3F     J8.37  gpio2_14 */       
/*					0x0C4     ???      J8.38  gpio2_15 */       
/*					0x0B8     0x3F     J8.39  gpio2_12 */       
/*					0x0BC     0x3F     J8.40  gpio2_13 */       
/*					0x0B0     0x3F     J8.41  gpio2_10 */       
/*					0x0B4     0x3F     J8.42  gpio2_11 */       
/*					0x0A8     0x3F     J8.43  gpio2_8  */       
/*					0x0AC     0x3F     J8.44  gpio2_9  */       
/*					0x0A0     0x3F     J8.45  gpio2_6  */       
/*					0x0A4     0x3F     J8.46  gpio2_7  */       
					                              
					0x070     0x3F  /* J9.11  gpio0_30 */       
					0x078     0x3F  /* J9.12  gpio1_28 */       
					0x074     0x3F  /* J9.13  gpio0_31 */       
					0x048     0x3F  /* J9.14  gpio1_18 */       
					0x040     0x3F  /* J9.15  gpio1_16 */       
					0x04C     0x3F  /* J9.16  gpio1_19 */       
					0x15C     0x3F  /* J9.17  gpio0_5  */       
					0x158     0x3F  /* J9.18  gpio0_4  */       
/*					0x17C     N/C      J9.19  gpio0_13 */       
/*					0x178     N/C      J9.20  gpio0_12 */       
					0x154     0x3F  /* J9.21  gpio0_3  */       
					0x150     0x3F  /* J9.22  gpio0_2  */       
					0x044     0x3F  /* J9.23  gpio1_17 */       
					0x184     0x3F  /* J9.24  gpio0_15 */       
					0x1AC     0x3F  /* J9.25  gpio3_21 */       
					0x180     0x3F  /* J9.26  gpio0_14 */       
					0x1A4     0x3F  /* J9.27  gpio3_19 */       
					0x19C     0x3F  /* J9.28  gpio3_17 */       
					0x194     0x3F  /* J9.29  gpio3_15 */       
					0x198     0x3F  /* J9.30  gpio3_16 */       
					0x190     0x3F  /* J9.31  gpio3_14 */       			
					0x1A8     0x3F  /* J9.41  gpio3_20 */       
					0x1A0     0x3F  /* J9.42  gpio3_18  */       
				>;
			};
		};
	};

	fragment@1 {
		target = <&pruss>;
		__overlay__ {
			status = "okay";

			pinctrl-names = "default";
			pinctrl-0 = <&K9_gpio_pins>;

		};
	};
};

